## package/iscsitarget/Config.in
```kconfig
config BR2_PACKAGE_ISCSITARGET
	bool "iscsitarget"
	select BR2_PACKAGE_OPENSSL
	help
	  The iSCSI Enterprise Target software allows export block devices
	  so they can be used as iSCSI Targets by other devices.

	  http://sourceforge.net/apps/mediawiki/iscsitarget

config BR2_PACKAGE_ISCSITARGET_KMOD
	bool 'compile the iscsitarget kernel module'
	depends on BR2_LINUX_KERNEL

comment "iscsitarget needs a Linux kernel to be built"
	depends on !BR2_LINUX_KERNEL
```

## package/python-cherrypy/Config.in
```kconfig
config BR2_PACKAGE_PYTHON_CHERRYPY
	bool "python-cherrypy"
	help
          CherryPy is a pythonic, object-oriented HTTP framework

          https://pypi.python.org/pypi/CherryPy
```

## package/python-flask-jsonrpc/Config.in
```kconfig
config BR2_PACKAGE_PYTHON_FLASK_JSONRPC
	bool "python-flask-jsonrpc"
	help
          flask-jsonrpc as a Python RPC Flask framework

          https://github.com/cenobites/flask-jsonrpc
```

## package/python-jsonpickle/Config.in
```kconfig
config BR2_PACKAGE_PYTHON_JSONPICKLE
	bool "python-jsonpickle"
	help
          jsonpickle is a Python library for serialization and deserialization of complex Python objects to and from JSON

          https://jsonpickle.github.io/
```

## package/stgt/Config.in
```kconfig
config BR2_PACKAGE_STGT
	bool "stgt"
	help
          stgt aims to simplify various SCSI target driver (iSCSI, Fibre Channel, SRP, etc) creation and maintenance

          http://stgt.sourceforge.net/
```
